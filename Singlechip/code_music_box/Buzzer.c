#include "reg52.h"  
#include "INTRINS.h"   // 包含内联汇编指令
#include "public.h"	

// 蜂鸣器端口
sbit Buzzer = P2^5;   

/*******************************************************************************
* 函 数 名      : delay_msus
* 函数功能		   : 延时函数，单位是 10 微秒
* 输    入       : x10us 延时的 10 微秒单位数
* 输    出    	 : 无
*******************************************************************************/

void delay_msus(u16 x10us)  //@12.000MHz
{
    while (x10us--)  
    {
        u8 i;
        _nop_();  // 空操作
        i = 2;
        while (--i); 
    }
}

/*******************************************************************************
* 函 数 名      : Buzzer_Freq
* 函数功能		   : 蜂鸣器发声函数
* 输    入       : Key，和相应的音调对应
* 输    出    	 : 无
*******************************************************************************/

void Buzzer_Freq(u16 Key)
{
    u16 i, N;
    u16 DesiredTime_ms = 100;   // 发音时间为100毫秒

    N = (DesiredTime_ms * 50) / Key;  // 计算需要反转的次数

    for (i = 0; i < N; i++)  
    {
        Buzzer = !Buzzer;  
        delay_msus(Key);   
    }
}
